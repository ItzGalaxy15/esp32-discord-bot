## sdkconfig.defaults
```kconfig
CONFIG_EXAMPLE_CONNECT_WIFI=y
CONFIG_EXAMPLE_PROVIDE_WIFI_CONSOLE_CMD=n

CONFIG_MBEDTLS_CERTIFICATE_BUNDLE=y
CONFIG_MBEDTLS_CERTIFICATE_BUNDLE_DEFAULT_FULL=y

CONFIG_ESP_MAIN_TASK_STACK_SIZE=8192
```
